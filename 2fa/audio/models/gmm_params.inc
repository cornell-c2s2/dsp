// autogenerated by speaker/dump_model.py

#ifndef GMM_PARAMS_INC
#define GMM_PARAMS_INC

#include <stdint.h>

#define K 32
#define D 13

#define Q_LOG_CONSTS 8
#define Q_MEANS 6
#define Q_INV_COVS 11

int16_t ubm_log_consts[K] = {
-3176,
-3258,
18505,
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-6027,
-3017
};

int8_t ubm_means[K][D] = {
{ 70, 27, -25, 88, -56, -84, -17, -4, -28, -64, 35, -20, -13 },
{ -24, -10, -38, -51, -10, 20, 11, 4, 32, 38, 19, -16, -11 },
{ 0, 0, 0, 0, 0, 0, 0, 0, 0, 0, 0, 0, 0 },
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{ -9, 56, 50, -20, -9, 24, 53, 19, -43, -61, -24, -7, 4 }
};

int32_t ubm_inv_covs[K][D] = {
{ 15797, 13212, 5782, 4673, 3688, 3630, 2048, 2264, 1941, 2572, 2222, 2084, 1796 },
{ 6888, 6793, 3369, 4607, 2735, 2340, 2436, 2061, 2325, 2315, 2041, 2235, 2208 },
{ 2047726134, 2048000000, 2048000000, 2048000000, 2048000000, 2048000000, 2048000000, 2048000000, 2048000000, 2048000000, 2048000000, 2048000000, 2048000000 },
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{ 10377, 13470, 4713, 5151, 3203, 3293, 4290, 2687, 2651, 2989, 2322, 2076, 2205 }
};

#ifdef DOUBLE_GMM

double ubm_log_consts_d[K] = {
-12.404673201737399,
-12.727661265963507,
72.28359002413919,
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-23.54482453626103,
-11.784457094479702
};

double ubm_means_d[K][D] = {
{ 1.0922295441533176, 0.4190198067656803, -0.39606547206500187, 1.3673974010894394, -0.8702661964859291, -1.3118762675656488, -0.27252721008136654, -0.06652736649566315, -0.443987849872846, -1.0009544632461242, 0.5502147413803632, -0.3201546691962321, -0.19929312028502116 },
{ -0.371828094020396, -0.15469221275663472, -0.5921355876934568, -0.7924952624675989, -0.16394407619573384, 0.3167647158751131, 0.17025066726008362, 0.060088613644973636, 0.5010035842079058, 0.5923379960985293, 0.29672383429111004, -0.2560166337340322, -0.17105332802234963 },
{ -1.81448380438985e-06, 0.0, 0.0, 0.0, 0.0, 0.0, 0.0, 0.0, 0.0, 0.0, 0.0, 0.0, 0.0 },
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{ -0.14616832784328335, 0.8677410990731294, 0.7735561152086267, -0.3082801796471699, -0.1416586897700117, 0.3789875285035496, 0.8309469081755663, 0.2948506191844764, -0.6677225148210127, -0.953917582721912, -0.37904318919601765, -0.10629504332149417, 0.05716830776156918 }
};

double ubm_inv_covs_d[K][D] = {
{ 7.713546802927528, 6.451243378927947, 2.823368799217016, 2.281605056102422, 1.8008439121295892, 1.772623668806713, 1.000119919696191, 1.1054077652417433, 0.9479145899677494, 1.2560675190712611, 1.0848736032659811, 1.017685478888839, 0.8771892684493604 },
{ 3.3633437356528275, 3.316686593824964, 1.6448408834450903, 2.249640013084645, 1.335505073674115, 1.1426859678879326, 1.1895562835298097, 1.0061328365186601, 1.135375855903866, 1.1301480803109063, 0.9964607227322124, 1.0915021811005416, 1.078034479179833 },
{ 999866.2765728154, 1000000.0, 1000000.0, 1000000.0, 1000000.0, 1000000.0, 1000000.0, 1000000.0, 1000000.0, 1000000.0, 1000000.0, 1000000.0, 1000000.0 },
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{ 5.067050313762053, 6.577057489036883, 2.301161362360797, 2.515174333789221, 1.5638283889348112, 1.6077744447566433, 2.094504757222437, 1.3121449581886304, 1.2946639895969312, 1.4592420553617038, 1.1336545847725434, 1.0136128366285346, 1.0765515395299907 }
};

#endif // DOUBLE_GMM

int16_t target_log_consts[K] = {
-3176,
-3258,
18505,
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-6027,
-3017
};

int8_t target_means[K][D] = {
{ 74, 35, -6, 90, -63, -85, -39, -30, -33, -61, 35, 21, -21 },
{ -42, -20, -51, -44, -7, 24, 28, 24, 36, 35, 12, -32, -15 },
{ 0, 0, 0, 0, 0, 0, 0, 0, 0, 0, 0, 0, 0 },
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{ -9, 46, 37, 1, 3, 25, 41, 11, -41, -57, -29, -12, 11 }
};

int32_t target_inv_covs[K][D] = {
{ 15797, 13212, 5782, 4673, 3688, 3630, 2048, 2264, 1941, 2572, 2222, 2084, 1796 },
{ 6888, 6793, 3369, 4607, 2735, 2340, 2436, 2061, 2325, 2315, 2041, 2235, 2208 },
{ 2047726134, 2048000000, 2048000000, 2048000000, 2048000000, 2048000000, 2048000000, 2048000000, 2048000000, 2048000000, 2048000000, 2048000000, 2048000000 },
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{ 10377, 13470, 4713, 5151, 3203, 3293, 4290, 2687, 2651, 2989, 2322, 2076, 2205 }
};

#ifdef DOUBLE_GMM

double target_log_consts_d[K] = {
-12.404673201737399,
-12.727661265963507,
72.28359002413919,
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-23.54482453626103,
-11.784457094479702
};

double target_means_d[K][D] = {
{ 1.150167231557206, 0.5474352346705842, -0.09774430451144979, 1.4135740316651129, -0.981715151845912, -1.3301377375456145, -0.6074121928166748, -0.47160320977435116, -0.5166401850021707, -0.953282444560235, 0.5506098433023645, 0.3327971190788309, -0.3231353174275437 },
{ -0.6578039303021816, -0.30697035352410745, -0.803901615924362, -0.6810415526286637, -0.11167474951900953, 0.370256171108464, 0.4376016023900883, 0.37279933256605724, 0.5619019417853315, 0.5545406024882245, 0.18248628083387658, -0.5044844384087933, -0.24120803389886958 },
{ -5.44345141316955e-07, 0.0, 0.0, 0.0, 0.0, 0.0, 0.0, 0.0, 0.0, 0.0, 0.0, 0.0, 0.0 },
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{ -0.14702206082185482, 0.7177697333395225, 0.5804033424422814, 0.01840267908606827, 0.04090118177767242, 0.3865955798403615, 0.6477390285965792, 0.1793096808894774, -0.6413477894406756, -0.896001690511077, -0.4456767845032705, -0.194631152883016, 0.17440616527738861 }
};

double target_inv_covs_d[K][D] = {
{ 7.713546802927528, 6.451243378927947, 2.823368799217016, 2.281605056102422, 1.8008439121295892, 1.772623668806713, 1.000119919696191, 1.1054077652417433, 0.9479145899677494, 1.2560675190712611, 1.0848736032659811, 1.017685478888839, 0.8771892684493604 },
{ 3.3633437356528275, 3.316686593824964, 1.6448408834450903, 2.249640013084645, 1.335505073674115, 1.1426859678879326, 1.1895562835298097, 1.0061328365186601, 1.135375855903866, 1.1301480803109063, 0.9964607227322124, 1.0915021811005416, 1.078034479179833 },
{ 999866.2765728154, 1000000.0, 1000000.0, 1000000.0, 1000000.0, 1000000.0, 1000000.0, 1000000.0, 1000000.0, 1000000.0, 1000000.0, 1000000.0, 1000000.0 },
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{ 5.067050313762053, 6.577057489036883, 2.301161362360797, 2.515174333789221, 1.5638283889348112, 1.6077744447566433, 2.094504757222437, 1.3121449581886304, 1.2946639895969312, 1.4592420553617038, 1.1336545847725434, 1.0136128366285346, 1.0765515395299907 }
};

#endif // DOUBLE_GMM

#endif // GMM_PARAMS_INC
